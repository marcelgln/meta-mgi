## build-configs/rpi0w/conf/bblayers.conf
```bitbake
# POKY_BBLAYERS_CONF_VERSION is increased each time build/conf/bblayers.conf
# changes incompatibly
POKY_BBLAYERS_CONF_VERSION = "2"

BBPATH = "${TOPDIR}"
BBFILES ?= ""
BSPDIR = "/home/marcel/ws-yocto/poky-dunfell"

BBLAYERS ?= " \
  ${BSPDIR}/meta \
  ${BSPDIR}/meta-poky \
  ${BSPDIR}/meta-yocto-bsp \
  ${BSPDIR}/meta-openembedded/meta-oe \
  ${BSPDIR}/meta-openembedded/meta-multimedia \
  ${BSPDIR}/meta-openembedded/meta-networking \
  ${BSPDIR}/meta-openembedded/meta-perl \
  ${BSPDIR}/meta-openembedded/meta-python \
  ${BSPDIR}/meta-raspberrypi \
  ${BSPDIR}/meta-mgi \
  "
```

## conf/layer.conf
```bitbake
# We have a conf and classes directory, add to BBPATH
BBPATH .= ":${LAYERDIR}"

# We have recipes-* directories, add to BBFILES
BBFILES += "${LAYERDIR}/recipes-*/*.bb \
            ${LAYERDIR}/recipes-*/*.bbappend \
	    ${LAYERDIR}/recipes-*/*/*.bb \
            ${LAYERDIR}/recipes-*/*/*.bbappend \
	    ${LAYERDIR}/recipes-*/*/*/*.bb \
            ${LAYERDIR}/recipes-*/*/*/*.bbappend \
"

BBFILE_COLLECTIONS += "mgi-layer"
BBFILE_PATTERN_mgi-layer = "^${LAYERDIR}/"

# set priority higher than meta-openembedded/meta-perl, because
# RDEPENDS_${PN} = "package (operator version)" seems not working well with
# libdbd-sqlite-perl (=1.34), increase priority of this layer to walk around.
BBFILE_PRIORITY_mgi-layer = "8"

LAYERDEPENDS_mgi-layer = "core perl-layer"
LAYERSERIES_COMPAT_mgi-layer = "dunfell"
```
